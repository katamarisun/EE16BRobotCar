/* integration.ino
** Processing Integration sketch for SIXT33N Speech version
** 
** EE16B Spring 2016
** Emily Naviasky & Nathaniel Mailoa
**
*/

//define constants
#define MIC_INPUT P6_0
#define SIZE 2752
#define SIZE_AFTER_FILTER 172


/*---------------*/
/* CODE BLOCK A1 */
/*---------------*/

// Enveloping and K-means constants
#define SNIPPET_SIZE 100 // YOUR CODE HERE 
#define PRELENGTH 5// YOUR CODE HERE 
#define THRESHOLD 0.5// YOUR CODE HERE 

#define KMEANS_THRESHOLD 0.0025 // YOUR CODE HERE 
#define LOUDNESS_THRESHOLD 700 // YOUR CODE HERE 

/*----------------------*/
/* END OF CODE BLOCK A1 */
/*----------------------*/

/*---------------*/
/* CODE BLOCK A2 */
/*---------------*/
//1 == shire
//2 == cheese
//3 == onetwothreefour
//4 == obama
//define arrays
float pca_vec1[SNIPPET_SIZE] = {0.0204715048746, 0.0106899791351, 0.00959835299711, 0.00523472097468, -0.00764873566005, -0.0346832168594, 0.0602004889621, 0.0623719008409, 0.103944013941, 0.128384782901, 0.132402537924, 0.0862806121469, 0.134921169388,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 -0.0727344553122, -0.0770079800809}; // YOUR CODE HERE
float pca_vec2[SNIPPET_SIZE] = {-0.0441721481537, -0.0419152350229, -0.0327134079229, -0.0414022762942, -0.00470682311858, -0.00916208794592, -0.0608549079583, -0.0422982372554, -0.0391978611156, -0.0465423157647, -0.0627051815745, -0.0614958681011, -0.0428860424471,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 -0.107955672035, -0.0812823888504}; // YOUR CODE HERE
float pca_vec3[SNIPPET_SIZE] = {-0.0100834001849, -0.00267728811961, -0.000135892397154, -0.00237724001523, -0.0208809987805, -0.0404105970281, 0.0431420823736, 0.0465721876011, 0.0186892729598, 0.00906734806144, -0.0292145623007, 0.0396135731768, -0.0173687505391,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 -0.00838016952827, -0.0389035689129}; // YOUR CODE HERE
float pca_vec4[SNIPPET_SIZE] = {-0.0682882780597, -0.0538108781088, 0.0149620786562, 0.05570731618, 0.0651760457997, -0.197577828391, -0.130623922184, -0.00521788482904, 0.0468994956237, 0.123315559235, 0.129024042612, 0.135829188042, 0.107273951726,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 0.0991681206029, 0.0789285112464}; // YOUR CODE HERE
float mean_vec[SNIPPET_SIZE] = {0.00431041197039, 0.00402934270977, 0.00411288889585, 0.00427355485926, 0.00619476278244, 0.013607147209, 0.0149080853075, 0.015222744457, 0.015080496995, 0.0153142309548, 0.0157117328957, 0.0163352514554, 0.0158936909767,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 0.00513154360826, 0.00491379975948}; // YOUR CODE HERE
float centroid1[3] = {0.00493517, -0.00530989, -0.00493843    }; // YOUR CODE HERE
float centroid2[3] = {0.0103423,  -0.0023534,  -0.00163616}; // YOUR CODE HERE
float centroid3[3] = {-0.00581314, -0.00179676, -0.00657997 }; // YOUR CODE HERE
float centroid4[3] = {-0.00995251,  0.00876388,  0.01096291 }; // YOUR CODE HERE
float result[SNIPPET_SIZE] = {0};


/*----------------------*/
/* END OF CODE BLOCK A2 */
/*----------------------*/


//data array and index pointer
int i=0;
int re[SIZE]={0};
volatile int re_pointer = 0;

//timer period
float timer_ms = 0.35;

// Enveloping function with thresholding and normalizing,
// returns snippet of interest (containing speech)
bool envelope(int*, float*);

// Compute the L2 norm of (dim1, dim2) and centroid
// input: dim1: 1st dimension coordinate
//        dim2: 2nd dimension coordinate
//        centroid: size-2 array containing centroid coordinates
// output: L2 norm (Euclidean distance) between point and centroid
float l2_norm(float dim1, float dim2, float* centroid){
  return sqrt(pow(dim1-centroid[0],2) + pow(dim2-centroid[1],2));
}

// Compute the L2 norm of (dim1, dim2, dim3) and centroid
// input: dim1: 1st dimension coordinate
//        dim2: 2nd dimension coordinate
//        dim3: 3rd dimension coordinate
//        centroid: size-3 array containing centroid coordinates
// output: L2 norm (Euclidean distance) between point and centroid
float l2_norm3(float dim1, float dim2, float dim3, float* centroid){
  return sqrt(pow(dim1-centroid[0],2) + pow(dim2-centroid[1],2)+ pow(dim3-centroid[2],2));
}

float inner_product(float* sample, float* component) {
  float sum = 0;
  for (int i = 0; i < SNIPPET_SIZE; i += 1) {
    sum += sample[i] * component[i];
  }
  return sum;
}


void setup()
{
  //microphone ADC
  pinMode(MIC_INPUT, INPUT);
  pinMode(P6_1, INPUT);
  pinMode(P6_5, INPUT);
  //recording light
  pinMode(RED_LED, OUTPUT);

  re_pointer = 0;
  reset_blinker();
  setTimer();
  
  Serial.begin(38400); 
}

void loop()
{  
  if(re_pointer == SIZE){
    digitalWrite(RED_LED, LOW);

    // Apply enveloping function and get snippet with speech. Do classification only if loud enough
    if(envelope(re, result)){

      /*--------------*/
      /* CODE BLOCK B */
      /*--------------*/

      // Perform principal component projection
      // YOUR CODE HERE 
      for (int i = 0; i < SNIPPET_SIZE; i += 1) {
        result[i] -= mean_vec[i];
      }
      float proj[3] = {inner_product(result, pca_vec1), inner_product(result, pca_vec2), inner_product(result, pca_vec3)};

      // Classification - Hint: use the function l2_norm defined below
      // YOUR CODE HERE 
      int closest = 1;
      float closest_dist = l2_norm3(proj[0], proj[1], proj[2], centroid1);
      float d2 = l2_norm3(proj[0], proj[1], proj[2], centroid2);
      float d3 = l2_norm3(proj[0], proj[1], proj[2], centroid3);
      float d4 = l2_norm3(proj[0], proj[1], proj[2], centroid4);
      if (d2 < closest_dist) {
        closest = 2;
        closest_dist = d2;
      }
      if (d3 < closest_dist) {
        closest = 3;
        closest_dist = d3;
      }
      if (d4 < closest_dist) {
        closest = 4;
        closest_dist = d4;
      }
      Serial.begin(38400);
      Serial.print(closest);
      /*---------------------*/
      /* END OF CODE BLOCK B */
      /*---------------------*/

    }
    
    delay(2000);
    re_pointer = 0;
  }
}


// Enveloping function with thresholding and normalizing,
// returns snippet of interest (containing speech)
bool envelope(int* data, float* data_out){
  int32_t avg = 0;
  float maximum = 0;
  int thres_index = 0;
  int32_t total = 0;
  int block;

  // Apply enveloping filter while finding maximum value
  for (block = 0; block < SIZE_AFTER_FILTER; block++){
    avg = 0;
    for (int i = 0; i < 16; i++) {
      avg += data[i+block*16];
    }
    avg = avg >> 4;
    data[block] = abs(data[block*16] - avg);
    for (int i = 1; i < 16; i++) {
      data[block] += abs(data[i+block*16] - avg);
    }
    if (data[block] > maximum) {
      maximum = data[block];
    }
  }
  
  // If not loud enough, return false
  if (maximum < LOUDNESS_THRESHOLD) return false;

  // Determine threshold
  float thres = THRESHOLD * maximum;

  // Figure out when interesting snippet starts and write to data_out
  block = PRELENGTH;
  while (data[block++] < thres);
  if (block > SIZE_AFTER_FILTER - SNIPPET_SIZE) 
    block = SIZE_AFTER_FILTER - SNIPPET_SIZE;
  for (int i = 0; i < SNIPPET_SIZE; i++){
    data_out[i] = data[block-PRELENGTH+i];
    total += data_out[i];
  }

  // Normalize data_out 
  for (int i = 0; i < SNIPPET_SIZE; i++)
    data_out[i] = data_out[i] / total;

  return true;
}



// Timer ISR for ADC sampling
#pragma vector=TIMER0_A0_VECTOR    // Timer A ISR
__interrupt void Timer1_A0_ISR( void )
{
  if(re_pointer < SIZE){
    digitalWrite(RED_LED, HIGH);
    re[re_pointer] = (analogRead(MIC_INPUT) >> 4) - 128;
    re_pointer += 1;
  }
}

// Set timer for ADC
void setTimer(){
  // set the timer based on 25MHz clock
  TA0CCR0 = (unsigned int)(25000*timer_ms);       
  // enable interrupts for Timer A
  TA0CCTL0 = CCIE;             
  __bis_SR_register(GIE);
  TA0CTL = TASSEL_2 + MC_1 + TACLR + ID_0;
}

void reset_blinker(){
  pinMode(RED_LED, OUTPUT);
  pinMode(GREEN_LED, OUTPUT);
  digitalWrite(RED_LED, HIGH);
  delay(100);
  digitalWrite(RED_LED, LOW);
  digitalWrite(GREEN_LED, HIGH);
  delay(100);
  digitalWrite(RED_LED, HIGH);
  digitalWrite(GREEN_LED, LOW);
  delay(100);
  digitalWrite(RED_LED, LOW);
  digitalWrite(GREEN_LED, HIGH);
  delay(100);
  digitalWrite(GREEN_LED, LOW);
}

